## conf/layer.conf
```bitbake
# We have a conf and classes directory, append to BBPATH
BBPATH .= ":${LAYERDIR}"

# We have a recipes directory, add to BBFILES
BBFILES += "${LAYERDIR}/recipes-*/*/*.bb ${LAYERDIR}/recipes-*/*/*.bbappend"

BBFILE_COLLECTIONS += "elm-binary-layer"
BBFILE_PATTERN_elm-binary-layer := "^${LAYERDIR}/"
BBFILE_PRIORITY_elm-binary-layer = "7"

LAYERDEPENDS_elm-binary-layer = ""
LAYERSERIES_COMPAT_elm-binary-layer = "kirkstone langdale mickledore nanbield"
```
